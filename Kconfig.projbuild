## Kconfig.projbuild
```kconfig
menu "ESP-Azure IoT"

config AZURE_TRANSPORT_PROTOCOL_HTTP
   bool "Azure Transport Protocol HTTP"
   default N
   help
     Select the Azure Transport Protocol HTTP

config AZURE_TRANSPORT_PROTOCOL_MQTT
   bool "Azure Transport Protocol MQTT"
   default N
   help
     Select the Azure Transport Protocol MQTT

config AZURE_TRANSPORT_PROTOCOL_MQTT_WEBSOCKET
   bool "Azure Transport Protocol MQTT over WEBSOCKET"
   default N
   help
     Select the Azure Transport Protocol MQTT over WEBSOCKET

config AZURE_TRANSPORT_PROTOCOL_AMQP
   bool "Azure Transport Protocol AMQP"
   default N
   help
     Select the Azure Transport Protocol AMQP

config AZURE_TRANSPORT_PROTOCOL_AMQP_WEBSOCKET
   bool "Azure Transport Protocol AMQP over WEBSOCKET"
   default Y
   help
     Select the Azure Transport Protocol AMQP over WEBSOCKET

config AZURE_CUSTOM_CERTIFICATES
   bool "Enable support for custom certificates"
   default N
   help
      Normaly certificates defines in Azure-iot-sdk-c is used.
      By enabling this flag certificates are read from the file custom_certs.c

endmenu
```
